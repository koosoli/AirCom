## main/Kconfig.projbuild
```kconfig
menu "AirCom Feature Configuration"

    config AIRCOM_FEATURE_NETWORK_HEALTH
        bool "Enable Network Health Monitor"
        default y
        help
            Enables the `network_health_task` which periodically sends health
            checks to peers to determine link quality (RSSI, latency). This
            adds a small amount of network overhead.

    config AIRCOM_FEATURE_SECURITY
        bool "Enable Advanced Security Features"
        default y
        help
            Enables the SecurityManager and the secure key exchange protocol.
            When disabled, all messages will be sent in plaintext.
            Requires the libsodium component.

    config AIRCOM_FEATURE_POWER_MANAGEMENT
        bool "Enable Role-Based Power Management"
        default y
        help
            Enables the ability to set a device's power role to ROUTER
            or SLEEPY_END_DEVICE. This allows for significant power savings
            on end nodes.

    config AIRCOM_FEATURE_SERVICE_DISCOVERY
        bool "Enable Service Discovery Protocol"
        default y
        help
            Enables the protocol for nodes to advertise their services
            (e.g., ATAK Gateway, Internet Gateway) in their discovery
            broadcasts.

    config AIRCOM_FEATURE_OTA_UPDATES
        bool "Enable Over-the-Air (OTA) Updates"
        default n
        help
            Enables the OTA update service. This will create a task that
            periodically checks for new firmware versions from a designated
            source. Increases flash size requirements.

    config AIRCOM_FEATURE_CAMERA
        bool "Enable Camera Service"
        default n
        help
            Enables the camera service for streaming low-framerate video
            and still images. Requires a camera to be connected to the device.

endmenu
```
